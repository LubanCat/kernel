## drivers/ebf_module/Kconfig
```kconfig
menu "Embedfire Modules"

menuconfig EBF_MODULE
	bool "Embedfire Modules"

if EBF_MODULE

config EBF_DHT11
	tristate "dht11"

config DS18B20
	tristate "ds18b20"

config INFRARED
	tristate "infrared"

endif # EBF_MODULE

endmenu
```

## drivers/input/touchscreen/hxchipset/Kconfig
```kconfig
#
# Himax Touchscreen driver configuration
#

config TOUCHSCREEN_HIMAX_COMMON
        tristate "HIMAX chipset touchscreen"
		depends on TOUCHSCREEN_HIMAX_CHIPSET
		help
		This enables support for HIMAX CHIPSET touchscreens.

config TOUCHSCREEN_HIMAX_IC_HX83102E
        tristate "HIMAX chipset HX83102E function"
		depends on TOUCHSCREEN_HIMAX_CHIPSET
		help
		This enables support for HIMAX CHIPSET of HX83102E.

config TOUCHSCREEN_HIMAX_IC_HX83102G
        tristate "HIMAX chipset HX83102G function"
		depends on TOUCHSCREEN_HIMAX_CHIPSET
		help
		This enables support for HIMAX CHIPSET of HX83102G.

config TOUCHSCREEN_HIMAX_IC_HX83108
        tristate "HIMAX chipset HX83108 function"
		depends on TOUCHSCREEN_HIMAX_CHIPSET
		help
		This enables support for HIMAX CHIPSET of HX83108.

config TOUCHSCREEN_HIMAX_IC_HX83102J
        tristate "HIMAX chipset HX83102J function"
		depends on TOUCHSCREEN_HIMAX_CHIPSET
		help
		This enables support for HIMAX CHIPSET of HX83102J.

config TOUCHSCREEN_HIMAX_IC_HX83112F
        tristate "HIMAX chipset HX83112f function"
		depends on TOUCHSCREEN_HIMAX_CHIPSET
		help
		This enables support for HIMAX CHIPSET of HX83112F.

config TOUCHSCREEN_HIMAX_IC_HX83121A
        tristate "HIMAX chipset HX83121A function"
		depends on TOUCHSCREEN_HIMAX_CHIPSET
		help
		This enables support for HIMAX CHIPSET of HX83121A.

config TOUCHSCREEN_HIMAX_IC_HX83122A
        tristate "HIMAX chipset HX83122A function"
		depends on TOUCHSCREEN_HIMAX_CHIPSET
		help
		This enables support for HIMAX CHIPSET of HX83122A.

config TOUCHSCREEN_HIMAX_IC_HX83123A
        tristate "HIMAX chipset HX83123A function"
		depends on TOUCHSCREEN_HIMAX_CHIPSET
		help
		This enables support for HIMAX CHIPSET of HX83123A.

config TOUCHSCREEN_HIMAX_IC_HX85200A
        tristate "HIMAX chipset HX85200A function"
		depends on TOUCHSCREEN_HIMAX_CHIPSET
		help
		This enables support for HIMAX CHIPSET of HX85200A.

config TOUCHSCREEN_HIMAX_IC_HX83132A
        tristate "HIMAX chipset HX83132A function"
		depends on TOUCHSCREEN_HIMAX_CHIPSET
		help
		This enables support for HIMAX CHIPSET of HX83132A.

config TOUCHSCREEN_HIMAX_DEBUG
        bool "HIMAX debug function"
		depends on TOUCHSCREEN_HIMAX_CHIPSET
		help
		This enables support for HIMAX debug function.
config TOUCHSCREEN_HIMAX_INSPECT
        bool "HIMAX inspect function"
		depends on TOUCHSCREEN_HIMAX_CHIPSET
		help
		This enables support for HIMAX inspect function.

config TOUCHSCREEN_HIMAX_EMBEDDED_FIRMWARE
	bool "HIMAX embedded firmware function"
		depends on TOUCHSCREEN_HIMAX_CHIPSET
		help
		This enables built-in FW inside kernel as binary array

config HMX_DB
	bool "HIMAX driver test over Dragon Board"
	depends on TOUCHSCREEN_HIMAX_CHIPSET
	help
	  This enables support for HIMAX driver test over Dragon Board.

config HIMAX_SUPPORT_KERNEL_419
        bool "HIMAX support kernel 4.19"
		depends on TOUCHSCREEN_HIMAX_CHIPSET
		help
		This enables support for support kernel 4.19.
```

## drivers/net/wireless/rockchip_wlan/aic8800_sdio/Kconfig
```kconfig
config AIC_WLAN_SDIO_SUPPORT
	bool "AIC sdio wireless Support"
	default n
	help
	  This is support for aic sdio wireless chip.

config AIC_FW_SDIO_PATH
	depends on AIC_WLAN_SDIO_SUPPORT
	string "sdio firmware & config file path"
	default "/usr/lib/firmware/aic8800/sdio"
	help
	  Path to the firmware & config file.

if AIC_WLAN_SDIO_SUPPORT
source "drivers/net/wireless/rockchip_wlan/aic8800_sdio/aic8800_fdrv/Kconfig"
source "drivers/net/wireless/rockchip_wlan/aic8800_sdio/aic8800_btlpm/Kconfig"
endif
```

## drivers/net/wireless/rockchip_wlan/aic8800_sdio/aic8800_btlpm/Kconfig
```kconfig
config AIC8800_SDIO_BTLPM_SUPPORT
	tristate "aic8800 sdio bluetooth Support"
	help
	  This is support for aic bluetooh driver.
```

## drivers/net/wireless/rockchip_wlan/aic8800_sdio/aic8800_fdrv/Kconfig
```kconfig
config AIC8800_SDIO_WLAN_SUPPORT
	tristate "aic8800 sdio wlan Support"
	help
	  This is support for aic wifi driver.
```

## drivers/net/wireless/rockchip_wlan/aic8800_usb/Kconfig
```kconfig
config AIC_WLAN_USB_SUPPORT
	bool "AIC usb wireless Support"
	default n
	help
	  This is support for aic wireless chip.

if AIC_WLAN_USB_SUPPORT
source "drivers/net/wireless/rockchip_wlan/aic8800_usb/aic8800_fdrv/Kconfig"
source "drivers/net/wireless/rockchip_wlan/aic8800_usb/aic_load_fw/Kconfig"
endif
```

## drivers/net/wireless/rockchip_wlan/aic8800_usb/aic8800/Kconfig
```kconfig
config AIC_WLAN_USB_SUPPORT
	bool "AIC wireless usb Support"
	default n
	help
	  This is support for aic wireless chip.

if AIC_WLAN_USB_SUPPORT
source "drivers/net/wireless/rockchip_wlan/aic8800_usb/aic8800/aic8800_fdrv/Kconfig"
source "drivers/net/wireless/rockchip_wlan/aic8800_usb/aic8800/aic_load_fw/Kconfig"
endif
```

## drivers/net/wireless/rockchip_wlan/aic8800_usb/aic8800/aic_load_fw/Kconfig
```kconfig
config AIC8800_LOADFW_USB_SUPPORT
	tristate "AIC8800 Load Firmware Support"
	help
	  This is support for aic load firmware driver.
```

## drivers/net/wireless/rockchip_wlan/aic8800_usb/aic_btusb/Kconfig
```kconfig
config AIC8800_BT_USB_SUPPORT
	tristate "AIC8800 bt usb Support"
	help
	  This is support for aic bluetooth driver.
```

## drivers/net/wireless/rockchip_wlan/aic8800_usb/aic_load_fw/Kconfig
```kconfig
config AIC_USB_LOADFW_SUPPORT
	tristate "AIC8800 usb Load Firmware Support"
	help
	  This is support for aic load firmware driver.
```

## drivers/net/wireless/rockchip_wlan/rtl8852ce/Kconfig
```kconfig
config RTL8852CE
	tristate "Realtek 8852C PCIE WiFi"
	depends on PCI
	help
	  Help message of RTL8852CE
```

## drivers/pcie_mhi/Kconfig
```kconfig
menu "Quectel PCIe MHI controllers"

config QUECTTEL_MHI_BUS
	tristate "Quectel Modem Host Interface (MHI) bus"
	help
	  Quectel Modem Bus driver for MHI protocol.

endmenu
```

## drivers/tty/serial/99xx/Kconfig
```kconfig
config SERIAL_99xx
	tristate "99xx/8250/16550 and compatible serial support"
	select SERIAL_CORE

config SERIAL_CH99xx_EXAR
	tristate "99xx/8250/16550 Exar/Commtech PCI/PCIe device support"
	depends on SERIAL_8250_PCI
	depends on SERIAL_99xx
	default SERIAL_8250
```
