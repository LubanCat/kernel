// SPDX-License-Identifier: (GPL-2.0+ OR MIT)
/*
 * Copyright (c) 2022 Rockchip Electronics Co., Ltd.
 *
 */

#include "arm64/rockchip/rk3528-evb3-lp4x-v10.dts"

/{
	model = "Rockchip RK3528 EVB3 LP4X V10 Board (AArch32)";
	compatible = "rockchip,rk3528-evb3-lp4x-v10", "rockchip,rk3528";
};
