// SPDX-License-Identifier: (GPL-2.0+ OR MIT)
/*
 * Copyright (c) 2022 Rockchip Electronics Co., Ltd.
 *
 */

#include "arm64/rockchip/rk3528-evb1-ddr4-v10.dts"

/ {
	model = "Rockchip RK3528 EVB1 DDR4 V10 Board (AArch32)";
	compatible = "rockchip,rk3528-evb1-ddr4-v10", "rockchip,rk3528";
};
