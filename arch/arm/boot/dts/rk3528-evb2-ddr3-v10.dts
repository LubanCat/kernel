// SPDX-License-Identifier: (GPL-2.0+ OR MIT)
/*
 * Copyright (c) 2022 Rockchip Electronics Co., Ltd.
 *
 */

#include "arm64/rockchip/rk3528-evb2-ddr3-v10.dts"

/{
	model = "Rockchip RK3528 EVB2 DDR3 V10 Board (AArch32)";
	compatible = "rockchip,rk3528-evb2-ddr3-v10", "rockchip,rk3528";
};
