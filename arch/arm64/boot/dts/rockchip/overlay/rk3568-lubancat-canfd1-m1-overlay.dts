/dts-v1/;
/plugin/;

#include <dt-bindings/clock/rk3568-cru.h>

/ {
	compatible = "rockchip,rk3568";

	fragment@0 {
		target = <&can1>;

		__overlay__ {
			status = "okay";
			compatible = "rockchip,rk3568-can-2.0";
			pinctrl-names = "default";
			assigned-clocks = <&cru CLK_CAN1>;
    		assigned-clock-rates = <100000000>;
        	pinctrl-0 = <&can1m1_pins>;
		};
	};
};