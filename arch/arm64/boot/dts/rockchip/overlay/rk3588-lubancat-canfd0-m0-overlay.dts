/dts-v1/;
/plugin/;

#include <dt-bindings/clock/rk3588-cru.h>

/ {
	fragment@0 {
		target = <&can0>;

		__overlay__ {
			status = "okay";
			compatible = "rockchip,canfd-1.0";
			assigned-clocks = <&cru CLK_CAN0>;
			assigned-clock-rates = <200000000>;
			pinctrl-names = "default";
			pinctrl-0 = <&can0m0_pins>;
		};
	};
};
