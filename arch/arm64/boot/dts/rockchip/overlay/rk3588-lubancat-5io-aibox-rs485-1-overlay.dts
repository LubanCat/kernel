/dts-v1/;
/plugin/;

#include <dt-bindings/gpio/gpio.h>
#include <dt-bindings/pinctrl/rockchip.h>

/ {
	fragment@0 {
		target = <&uart5>;

		__overlay__ {
			status = "okay";
			pinctrl-names = "default";
			pinctrl-0 = <&uart5m1_xfer>;
			rs485-de-gpios = <&gpio7 9 GPIO_ACTIVE_HIGH>;
		};
	};
};
