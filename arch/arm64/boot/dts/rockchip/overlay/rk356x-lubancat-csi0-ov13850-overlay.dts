/ {
	fragment@0 {
		target = <&ov13850>;
		__overlay__ {
			status = "okay";
		};
	};
	
	fragment@1 {
		target = <&dw9714>;
		__overlay__ {
			status = "okay";
		};
	};

	fragment@2 {
		target = <&i2c1>;
		__overlay__ {
			status = "okay";
		};
	};
};