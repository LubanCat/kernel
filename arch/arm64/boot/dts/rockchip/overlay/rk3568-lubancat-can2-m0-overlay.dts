/dts-v1/;
/plugin/;

#include <dt-bindings/clock/rk3568-cru.h>

/ {
	compatible = "rockchip,rk3568";

	fragment@0 {
		target = <&can2>;

		__overlay__ {
			status = "okay";
			compatible = "rockchip,rk3568-can-2.0";
			pinctrl-names = "default";
			assigned-clocks = <&cru CLK_CAN2>;
    		assigned-clock-rates = <200000000>;
			pinctrl-0 = <&can2m0_pins>;
		};
	};
};