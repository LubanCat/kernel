/dts-v1/;
/plugin/;

#include <dt-bindings/gpio/gpio.h>
#include <dt-bindings/pinctrl/rockchip.h>

/ {
	fragment@0 {
		target = <&uart4>;

		__overlay__ {
			status = "okay";
			pinctrl-names = "default";
			pinctrl-0 = <&uart4m2_xfer &rs485_1_rts>;
			rs485-de-gpios = <&gpio3 RK_PC7 GPIO_ACTIVE_HIGH>;
		};
	};

	fragment@1 {
		target = <&pinctrl>;
		__overlay__ {
		rs485_rts {
			rs485_1_rts:rs485_1_rts{
				rockchip,pins =
					<3 RK_PC7 RK_FUNC_GPIO &pcfg_pull_none>;
				};
			};
		};
	};
};
