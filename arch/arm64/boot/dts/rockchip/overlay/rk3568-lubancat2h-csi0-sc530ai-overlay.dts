/dts-v1/;
/plugin/;

#include <dt-bindings/gpio/gpio.h>
#include <dt-bindings/pinctrl/rockchip.h>

/ {
	fragment@2 {
		target = <&i2c1>;
		__overlay__ {
			status = "okay";
		};
	};

	fragment@3 {
		target = <&sc530ai>;
		__overlay__ {
			status = "okay";

			pwdn-gpios = <&gpio2 RK_PB1 GPIO_ACTIVE_HIGH>;
			reset-gpios = <&gpio2 RK_PB2 GPIO_ACTIVE_HIGH>;
		};
	};
};
