/dts-v1/;
/plugin/;

#include <dt-bindings/gpio/gpio.h>
#include <dt-bindings/pinctrl/rockchip.h>
#include <dt-bindings/display/drm_mipi_dsi.h>
#include <dt-bindings/interrupt-controller/irq.h>

/ {
	fragment@0 {
		target = <&dp0_sound>;

		__overlay__ {
			status = "disabled";
		};
	};

	fragment@1 {
		target = <&dp0>;

		__overlay__ {
			status = "disabled";
		};
	};

	fragment@2 {
		target = <&dp0_in_vp1>;

		__overlay__ {
			status = "disabled";
		};
	};

	fragment@3 {
		target = <&route_dp0>;

		__overlay__ {
			status = "disabled";
		};
	};
};