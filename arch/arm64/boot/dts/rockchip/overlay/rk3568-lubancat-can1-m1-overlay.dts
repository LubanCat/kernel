/dts-v1/;
/plugin/;
#include <dt-bindings/clock/rk3568-cru.h>

/ {
	compatible = "rockchip,rk3568";

	fragment@0 {
		target = <&can1>;

		__overlay__ {
			status = "okay";
			compatible = "rockchip,rk3568-can-2.0";
			assigned-clocks = <&cru CLK_CAN1>;
    		assigned-clock-rates = <200000000>;
			pinctrl-names = "default";
        	pinctrl-0 = <&can1m1_pins>;
		};
	};
};