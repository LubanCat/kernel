/dts-v1/;
/plugin/;

/ {
	fragment@0 {
		target = <&pcie2x1l1>;

		__overlay__ {
			status = "disabled";
		};
	};

	fragment@1 {
		target = <&sata2>;

		__overlay__ {
			status = "okay";
			vpcie3v3-supply = <&vcc3v3_mini_pcie>;
		};
	};
};
