/dts-v1/;
/plugin/;

#include <dt-bindings/gpio/gpio.h>
#include <dt-bindings/pinctrl/rockchip.h>

/ {
	fragment@0 {
		target = <&uart6>;

		__overlay__ {
			status = "okay";
			pinctrl-names = "default";
			pinctrl-0 = <&uart6m1_xfer>;
			rs485-de-gpios = <&gpio7 10 GPIO_ACTIVE_HIGH>;
		};
	};
};
