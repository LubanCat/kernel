/dts-v1/;
/plugin/;

/ {
	fragment@0 {
		target = <&ov8858>;
		__overlay__ {
			status = "okay";
			rockchip,ov8858-capture-mode = <1>;
		};
	};

	fragment@1 {
		target = <&dw9714>;
		__overlay__ {
			status = "okay";
		};
	};

	fragment@2 {
		target = <&i2c1>;
		__overlay__ {
			status = "okay";
		};
	};
};
