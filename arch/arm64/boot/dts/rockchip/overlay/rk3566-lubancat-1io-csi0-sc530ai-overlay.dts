/dts-v1/;
/plugin/;

#include <dt-bindings/gpio/gpio.h>
#include <dt-bindings/pinctrl/rockchip.h>

/ {
	fragment@0{
		target = <&i2c1>;
		__overlay__ {
			status = "okay";
		};
	};

	fragment@1 {
		target = <&sc530ai>;
		__overlay__ {
			status = "okay";

            pwdn-gpios = <&gpio3 RK_PA2 GPIO_ACTIVE_HIGH>;
			reset-gpios = <&gpio2 RK_PA7 GPIO_ACTIVE_HIGH>;
		};
	};
};
