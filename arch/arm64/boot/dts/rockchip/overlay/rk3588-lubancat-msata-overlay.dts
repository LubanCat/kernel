/dts-v1/;
/plugin/;

/ {
	fragment@0 {
		target = <&pcie2x1l2>;

		__overlay__ {
			status = "disabled";
		};
	};

	fragment@1 {
		target = <&sata0>;

		__overlay__ {
			status = "okay";
			vpcie3v3-supply = <&vcc3v3_pcie20>;
		};
	};
};
