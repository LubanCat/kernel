/dts-v1/;
/plugin/;

/ {
	fragment@0 {
		target = <&imx415_test>;
		__overlay__ {
			status = "okay";
            rockchip,imx415-data-lanes= <4>;
		};
	};

	fragment@1 {
		target = <&imx415_out1>;
		__overlay__ {
				data-lanes = <1 2 3 4>;
		};
	};

	fragment@2 {
		target = <&i2c0>;
		__overlay__ {
			status = "okay";
		};
	};
};
