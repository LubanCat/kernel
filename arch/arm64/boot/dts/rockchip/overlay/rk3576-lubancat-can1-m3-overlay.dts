/dts-v1/;
/plugin/;

#include <dt-bindings/clock/rk3588-cru.h>

/ {
	fragment@0 {
		target = <&can1>;

		__overlay__ {
			status = "okay";
			assigned-clocks = <&cru CLK_CAN1>;
			assigned-clock-rates = <100000000>;
			pinctrl-names = "default";
			pinctrl-0 = <&can1m3_pins>;
		};
	};
};
