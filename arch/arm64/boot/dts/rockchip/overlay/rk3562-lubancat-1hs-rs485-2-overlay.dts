/dts-v1/;
/plugin/;

#include <dt-bindings/gpio/gpio.h>
#include <dt-bindings/pinctrl/rockchip.h>

/ {
	fragment@0 {
		target = <&uart9>;

		__overlay__ {
			pinctrl-names = "default";
			pinctrl-0 = <&uart9m1_xfer &rs485_2_rts>;
			rs485-de-gpios = <&gpio3 RK_PC1 GPIO_ACTIVE_HIGH>;
			status = "okay";
		};
	};

	fragment@1 {
		target = <&pinctrl>;
		__overlay__ {
		rs485_rts {
			rs485_2_rts:rs485_2_rts{
				rockchip,pins =
					<3 RK_PC1 RK_FUNC_GPIO &pcfg_pull_none>;
				};
			};
		};
	};
};
