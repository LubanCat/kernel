/dts-v1/;
/plugin/;

#include <dt-bindings/clock/rk3562-cru.h>

/ {
	fragment@0 {
		target = <&can0>;

		__overlay__ {
			compatible = "rockchip,rk3562-canfd";
			status = "okay";
			assigned-clocks = <&cru CLK_CAN0>;
			assigned-clock-rates = <200000000>;
			pinctrl-names = "default";
			pinctrl-0 = <&can0m2_pins>;
		};
	};
};
