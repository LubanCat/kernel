/dts-v1/;
/plugin/;

#include <dt-bindings/gpio/gpio.h>
#include <dt-bindings/pinctrl/rockchip.h>

/ {
	fragment@0 {
		target = <&spi1>;

		__overlay__ {
			status = "okay";
			#address-cells = <1>;
			#size-cells = <0>;
			// SPI gpio模拟cs信号 
			pinctrl-names = "default";
			pinctrl-0 = <&spi1m1_cs0 &spi1m1_pins>;
			cs-gpios = <&gpio3 RK_PA6 GPIO_ACTIVE_LOW>;
			num-cs = <1>;

			spi_dev@0 {
				compatible = "rockchip,spidev";
				reg = <0>; //chip select 0:cs0  1:cs1
				spi-max-frequency = <24000000>; //spi output clock
			};
		};
	};
};
