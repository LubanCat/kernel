// SPDX-License-Identifier: (GPL-2.0+ OR MIT)
/*
 * Copyright (c) 2024 Rockchip Electronics Co., Ltd.
 * Copyright (c) 2026 EmbedFire <embedfire@embedfire.com>
 */

/dts-v1/;

#include "rk3576-lubancat-3.dts"

/ {
	model = "EmbedFire LubanCat-3-v2";
	compatible = "embedfire,rk3576-lubancat-3-v2", "rockchip,rk3576";
};

&i2c2_hym8563 {
    status = "disabled";
};

&i2c3 {
	pinctrl-names = "default";
	pinctrl-0 = <&i2c3m0_xfer>;
	status = "okay";

	/* bm8563 rtc chip use rtc-hym8563 driver */
	i2c3_hym8563: i2c3-hym8563@51 {
		compatible = "haoyu,hym8563";
		reg = <0x51>;
		#clock-cells = <0>;
		clock-frequency = <32768>;
		clock-output-names = "hym8563";
		pinctrl-names = "default";
		pinctrl-0 = <&hym8563_int>;
		interrupt-parent = <&gpio0>;
		interrupts = <RK_PA5 IRQ_TYPE_LEVEL_LOW>;
		wakeup-source;
	};
};